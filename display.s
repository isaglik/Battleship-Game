; Sets up SSI0, PA6-PA2 to work with the
; Nokia 5110

; Pin connections
; ------------------------------------------
; 3.3V			(VCC) connected to 3.3V
; Ground 		(GND) CONNECTED TO Grpund
; SSI0Fss  		(SCE) connected to PA3
; Reset         (RST) connected to PA7
; Data/Command  (D/C) connected to PA6
; SSI0Tx        (DN)  connected to PA5
; SSI0Clk       (SCL) connected to PA2
; back light    (LED) connected to VCC

;GPIO Registers
GPIO_PORTA_DATA			EQU	0x400043FC	; Port A Data
GPIO_PORTA_IM      		EQU 0x40004010	; Interrupt Mask
GPIO_PORTA_DIR   		EQU 0x40004400	; Port Direction
GPIO_PORTA_AFSEL 		EQU 0x40004420	; Alt Function enable
GPIO_PORTA_DEN   		EQU 0x4000451C	; Digital Enable
GPIO_PORTA_AMSEL 		EQU 0x40004528	; Analog enable
GPIO_PORTA_PCTL  		EQU 0x4000452C	; Alternate Functions

GPIO_PORTB_DATA			EQU	0x400053FC	; Port B Data
GPIO_PORTB_IM      		EQU 0x40005010	; Interrupt Mask
GPIO_PORTB_DIR   		EQU 0x40005400	; Port Direction
GPIO_PORTB_AFSEL 		EQU 0x40005420	; Alt Function enable
GPIO_PORTB_DEN   		EQU 0x4000551C	; Digital Enable
GPIO_PORTB_AMSEL 		EQU 0x40005528	; Analog enable
GPIO_PORTB_PCTL  		EQU 0x4000552C	; Alternate Functions
	
;SSI Registers
SSI0_CR0				EQU	0x40008000
SSI0_CR1				EQU	0x40008004
SSI0_DR					EQU	0x40008008
SSI0_SR					EQU	0x4000800C
SSI0_CPSR				EQU	0x40008010
SSI0_CC					EQU	0x40008FC8
	
;System Registers
SYSCTL_RCGCGPIO  		EQU 0x400FE608	; GPIO Gate Control
SYSCTL_RCGCSSI			EQU	0x400FE61C	; SSI Gate Control
	
	    AREA    timer, CODE, READONLY
        THUMB

		EXPORT	Nokia_Init
		EXPORT	Out1BNokia
		EXPORT	OutImgNokia
		EXPORT	SetXYNokia
		EXPORT	OutCharNokia
		EXPORT	OutStrNokia
		EXPORT	ClearNokia
		EXPORT	OutCrsUNokia
		EXPORT	OutCrsLNokia	
		EXPORT	Cleargamefield
		EXPORT  OutBUNokia
		EXPORT  OutBLNokia
		EXPORT  OutCUNokia			
		EXPORT  OutCLNokia
		EXPORT	hfmessage
			
; ASCII table for characters to be displayed
ASCII	DCB		0x00, 0x00, 0x00, 0x00, 0x00 ;// 20
		DCB		0x00, 0x00, 0x5f, 0x00, 0x00 ;// 21 !
		DCB		0x00, 0x07, 0x00, 0x07, 0x00 ;// 22 "
		DCB		0x14, 0x7f, 0x14, 0x7f, 0x14 ;// 23 #
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  		DCB		0x10, 0x08, 0x08, 0x10, 0x08 ;// 7e ~
clearfield
        DCB		0xff, 0xff, 0xff, 0xff, 0xff, 0xff, 0x00, 0x00, 0x00, 0x00, 0x00, 0x00, 0x00, 0x00
        DCB		0x00, 0x00, 0x00, 0x00, 0x00, 0x00, 0x00, 0x00, 0x00, 0x00, 0x00, 0x00, 0x00, 0x00
        DCB		0x00, 0x00, 0x00, 0x00, 0x00, 0x00, 0x00, 0x00, 0x00, 0x00, 0x00, 0x00, 0x00, 0x00
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        DCB		0xff, 0xff, 0xff, 0xff, 0xff, 0xff, 0xff, 0xff, 0xff, 0xff, 0xff, 0xff, 0xff, 0xff
		
cursorU		DCB		0x04, 0x04, 0x1F, 0x04, 0x04
			DCB		0x08, 0x08, 0x3E, 0x08, 0x08
			DCB		0x10, 0x10, 0x7C, 0x10, 0x10
			DCB		0x20, 0x20, 0xF8, 0x20, 0x20
			DCB		0x40, 0x40, 0xF0, 0x40, 0x40
			DCB		0x80, 0x80, 0xE0, 0x80, 0x80
			DCB		0x00, 0x00, 0xC0, 0x00, 0x00
			DCB		0x00, 0x00, 0x80, 0x00, 0x00
cursorL		DCB		0x00, 0x00, 0x01, 0x00, 0x00
			DCB		0x00, 0x00, 0x03, 0x00, 0x00
			DCB		0x01, 0x01, 0x07, 0x01, 0x01
			DCB		0x02, 0x02, 0x0F, 0x02, 0x02


bshipU		DCB		0x7f, 0x7f, 0x7f, 0x7f, 0x7f, 0x7f, 0x7f
			DCB		0xfe, 0xfe, 0xfe, 0xfe, 0xfe, 0xfe, 0xfe
			DCB		0xfc, 0xfc, 0xfc, 0xfc, 0xfc, 0xfc, 0xfc
			DCB		0xf8, 0xf8, 0xf8, 0xf8, 0xf8, 0xf8, 0xf8
			DCB		0xf0, 0xf0, 0xf0, 0xf0, 0xf0, 0xf0, 0xf0
			DCB		0xe0, 0xe0, 0xe0, 0xe0, 0xe0, 0xe0, 0xe0
			DCB		0xc0, 0xc0, 0xc0, 0xc0, 0xc0, 0xc0, 0xc0
			DCB		0x80, 0x80, 0x80, 0x80, 0x80, 0x80, 0x80
bshipL		DCB		0x00, 0x00, 0x00, 0x00, 0x00, 0x00, 0x00
			DCB		0x00, 0x00, 0x00, 0x00, 0x00, 0x00, 0x00
            DCB		0x01, 0x01, 0x01, 0x01, 0x01, 0x01, 0x01 
            DCB		0x03, 0x03, 0x03, 0x03, 0x03, 0x03, 0x03
            DCB		0x07, 0x07, 0x07, 0x07, 0x07, 0x07, 0x07 
            DCB		0x0F, 0x0F, 0x0F, 0x0F, 0x0F, 0x0F, 0x0F 
            DCB		0x1F, 0x1F, 0x1F, 0x1F, 0x1F, 0x1F, 0x1F
            DCB		0x3F, 0x3F, 0x3F, 0x3F, 0x3F, 0x3F, 0x3F
   
cshipU		DCB		0x7f, 0x41, 0x41, 0x41, 0x41, 0x41, 0x7f
			DCB		0xfe, 0x82, 0x82, 0x82, 0x82, 0x82, 0xfe
			DCB		0xfc, 0x04, 0x04, 0x04, 0x04, 0x04, 0xfc
			DCB		0xf8, 0x08, 0x08, 0x08, 0x08, 0x08, 0xf8
			DCB		0xf0, 0x10, 0x10, 0x10, 0x10, 0x10, 0xf0
            DCB		0xe0, 0x20, 0x20, 0x20, 0x20, 0x20, 0xe0
            DCB		0xc0, 0x40, 0x40, 0x40, 0x40, 0x40, 0xc0
            DCB		0x80, 0x80, 0x80, 0x80, 0x80, 0x80, 0x80
cshipL      DCB		0x00, 0x00, 0x00, 0x00, 0x00, 0x00, 0x00
            DCB		0x00, 0x00, 0x00, 0x00, 0x00, 0x00, 0x00
            DCB		0x01, 0x01, 0x01, 0x01, 0x01, 0x01, 0x01
            DCB		0x03, 0x02, 0x02, 0x02, 0x02, 0x02, 0x03
            DCB		0x07, 0x04, 0x04, 0x04, 0x04, 0x04, 0x07
            DCB		0x0f, 0x08, 0x08, 0x08, 0x08, 0x08, 0x0f
            DCB		0x1f, 0x10, 0x10, 0x10, 0x10, 0x10, 0x1f
            DCB		0x3f, 0x20, 0x20, 0x20, 0x20, 0x20, 0x3f
faultmsg	DCB		"Hard Fault :( ",0x04
		SPACE	1		; added for padding

;*****************************************************************
; Initializes Nokia display
Nokia_Init
		PUSH	{LR}
	;Setup GPIO
		LDR 	R1, =SYSCTL_RCGCGPIO	; start GPIO clock
		LDR 	R0, [R1]                   
		ORR 	R0, #0x01				; set bit 0	
		STR 	R0, [R1]                   
		NOP								; allow clock to settle
		NOP
		NOP								
		LDR		R1,=GPIO_PORTA_DIR		; make PA2,3,5,6,7 output
		MOV 	R0, #0xEC				; and make PA4 input
		STR		R0,[R1]
		LDR		R1,=GPIO_PORTA_AFSEL	; enable alt funct on PA2,3,4,5
		MOV 	R0, #0x3C				;
		STR		R0,[R1]
		LDR		R1,=GPIO_PORTA_DEN		; enable digital I/O at PA2,3,4,5,6,7
		MOV 	R0, #0xFC				;
		STR		R0,[R1]					
		LDR		R1,=GPIO_PORTA_PCTL 	; configure PA2,3,4,5 as SSI
		LDR 	R0, =0x00222200			; set 2,3,4 and 5 nibble		
		STR		R0,[R1]
		LDR		R1,=GPIO_PORTA_AMSEL	; disable analog functionality
		LDR		R0, [R1]
		BIC 	R0, #0xFC				;
		STR		R0,[R1]
		
	;Setup SSI	
		LDR 	R1,=SYSCTL_RCGCSSI		; start SSI clock
		LDR 	R0,[R1]                   
		ORR 	R0, #0x01				; set bit 0 for SSI0
		STR 	R0,[R1]                
		; small delay
		MOV		R0,#0x0F
waitSSIClk								; allow clock to settle
		SUBS	R0,R0,#0x01
		BNE		waitSSIClk

		LDR		R1,=SSI0_CR1			; disable SSI during setup and also set to Master
		MOV		R0, #0x00				; clear bit 1	and  clear bit 2 (you can clear all bits)
		STR		R0,[R1]
		
		; Configure baud rate PIOSC=16MHz,Baud=2MHz,CPSDVSR=4,SCR=1
		; BR=SysClk/(CPSDVSR * (1 + SCR))
		LDR		R1,=SSI0_CC				; use PIOSC (16MHz)		
		MOV		R0,#0x05				; set bits 3:0 of the SSICC to 0x5 
		STR		R0,[R1]
		LDR		R1,=SSI0_CR0			; set SCR bits to 0x01
		LDR		R0,[R1]
		ORR		R0, #0x0100				;
		STR		R0,[R1]
		LDR		R1,=SSI0_CPSR			; set CPSDVSR (prescale) to 0x04
		MOV 	R0, #0x04				;
		STR		R0,[R1]
		LDR		R1,=SSI0_CR0			; clear SPH,SPO
		LDR		R0,[R1]					; choose Freescale frame format
		BIC		R0, #0x3F				; clear bits 5:4 	
		ORR		R0, #0x07				; choose 8-bit data (set DSS bits to 0x07)
		STR		R0,[R1]
		LDR		R1,=SSI0_CR1			; enable SSI
		LDR		R0,[R1]
		ORR 	R0, #0x02				; set bit 1
		STR		R0,[R1]
	
	; Reset LCD memory	
	; ensure reset is low
		LDR		R1,=GPIO_PORTA_DATA	
		LDR		R0, [R1]
		BIC 	R0, #0x80					; clear reset(PA7) 	
		STR		R0,[R1]
	
		MOV		R0,#10
delReset		
		SUBS	R0,R0,#1
		BNE		delReset
		
		LDR		R1,=GPIO_PORTA_DATA		; 
		ORR 	R0, #0x80				; set reset(PA7)
		STR		R0,[R1]					;
		
	; Setup LCD
		LDR		R1,=GPIO_PORTA_DATA		; set PA6 low for Command
		LDR		R0,[R1]
		BIC 	R0, #0x40				;
		STR		R0,[R1]
		
		;chip active (PD=0)
		;horizontal addressing (V=0)
		;extended instruction set (H=1)
		MOV		R5,#0x21
		BL		Out1BNokia	
		;set contrast
		MOV		R5,#0xB8
		BL		Out1BNokia
		;set temp coefficient
		MOV		R5,#0x04
		BL		Out1BNokia
		;set bias 1:48: try 0x13 or 0x14
		MOV		R5,#0x14
		BL		Out1BNokia
		;change H=0
		MOV		R5,#0x20
		BL		Out1BNokia
		;set control mode to normal
		MOV		R5,#0x0C
		BL		Out1BNokia
		; clear screen
		; screen memory is undefined after startup
		BL		ClearNokia
		
waitCMDDone		
		LDR		R1,=SSI0_SR				; wait until SSI is done
		LDR		R0,[R1]
		ANDS	R0,R0,#0x10
		BNE		waitCMDDone
		
		POP{LR}
		BX		LR
;*****************************************************************		

;*****************************************************************	
; SSI Send routine. Bits to be sent passed via R5
Out1BNokia
		PUSH	{R0,R1}
waitSendNokia		
		LDR		R1,=SSI0_SR				; wait if buffer is full
		LDR		R0,[R1]
		ANDS	R0,R0,#0x02
		BEQ		waitSendNokia
		LDR		R1,=SSI0_DR
		STRB	R5,[R1]
		POP		{R0,R1}
		BX		LR
;*****************************************************************			

;*****************************************************************
; Send Image to Nokia routine	
OutImgNokia
		PUSH	{R0-R4,LR}
		PUSH	{R5}					; save Img address
		LDR		R1,=GPIO_PORTA_DATA		; set PA6 low for Command
		LDR		R0,[R1]
		BIC		R0,#0x40
		STR		R0,[R1]
		MOV		R5,#0x20				;  H=0
		BL		Out1BNokia	
		MOV		R5,#0x40				; set Y address to 0
		BL		Out1BNokia
		MOV		R5,#0x80				; set X address to 0
		BL		Out1BNokia	
waitImgReady		
		LDR		R1,=SSI0_SR				; wait until SSI is done
		LDR		R0,[R1]
		ANDS	R0,R0,#0x10
		BNE		waitImgReady
		LDR		R1,=GPIO_PORTA_DATA		; ready: set PA6 high for Data
		LDR		R0,[R1]
		ORR		R0,#0x40
		STR		R0,[R1]	
		POP		{R5}
		MOV		R0,#504					; 504 bytes in full image
		MOV		R1,R5					; put img address in R1
sendNxtByteNokia		
		LDRB	R5,[R1],#1		; load R5 with byte, post inc address
		BL		Out1BNokia
		SUBS	R0,#1
		BNE		sendNxtByteNokia		
		POP		{R0-R4,LR}
		BX		LR
;*****************************************************************
;*****************************************************************
; Set X,Y coordinates of LCD		
SetXYNokia	
	; X values 0-83 passed via R0
	; Y values 0-5  passed via R1
	; DC is left high, so data can be sent after
		PUSH	{R0-R5,LR}
		PUSH	{R0-R1}
		LDR		R1,=GPIO_PORTA_DATA		; set PA6 low for Command
		LDR		R0,[R1]
		BIC		R0,#0x40
		STR		R0,[R1]
		MOV		R5,#0x20				; ensure H=0
		BL		Out1BNokia	
		POP		{R0-R1}
		MOV		R5,R1					; set Y address
		ORR		R5,#0x40
		BL		Out1BNokia
		MOV		R5,R0					; set X address
		ORR		R5,#0x80
		BL		Out1BNokia
waitXYCMD		
		LDR		R1,=SSI0_SR				; wait until SSI is done
		LDR		R0,[R1]
		ANDS	R0,R0,#0x10
		BNE		waitXYCMD
		LDR		R1,=GPIO_PORTA_DATA		; set PA6 high for Data
		LDR		R0,[R1]
		ORR		R0,#0x40
		STR		R0,[R1]
		POP		{R0-R5,LR}
		BX		LR
;*****************************************************************
;*****************************************************************
; output ASCII character to LCD screen
; ASCII hex value passed via R5
OutCharNokia
		PUSH	{R0-R4,LR}
		LDR		R1,=GPIO_PORTA_DATA		; set PA6 high for Data
		LDR		R0,[R1]
		ORR		R0,#0x40
		STR		R0,[R1]
		LDR		R1,=ASCII				; load address of ASCII table
		SUB		R2,R5,#0x20				; calculate offset of char
		MOV		R3,#0x05
		MUL		R2,R2,R3
		ADD		R1,R1,R2
		PUSH	{R5}					; save state of R5
		MOV		R0,#0x05				; 5 bytes in every char
		MOV		R2,#0x00				; 1 empty column between chars
sendCharByte		
		LDRB	R5,[R1],#1				
		BL		Out1BNokia				; send each byte of char
		SUBS	R0,R0,#1
		BNE		sendCharByte
		MOV		R5,R2
		BL		Out1BNokia				; add space on after char
waitCharDone		
		LDR		R1,=SSI0_SR				; wait until SSI is done
		LDR		R0,[R1]
		ANDS	R0,R0,#0x10
		BNE		waitCharDone
		POP		{R5}
		POP		{R0-R4,LR}
		BX		LR
;*****************************************************************	
;*****************************************************************
; output ASCII string to LCD screen
; Address of start of message passed via R5
; Ended using character 0x04
OutStrNokia		
		PUSH	{R0-R5,LR}
		MOV		R1,R5
nextStrChar
		LDRB	R5,[R1],#1
		CMP		R5,#0x04
		BEQ		doneStrNokia
		BL		OutCharNokia
		B		nextStrChar
doneStrNokia
		POP		{R0-R5,LR}
		BX		LR
;*****************************************************************
;*****************************************************************
; clear screen
ClearNokia
		PUSH	{R0-R5,LR}
		LDR		R1,=GPIO_PORTA_DATA		; set PA6 low for Command
		LDR		R0,[R1]
		BIC		R0,#0x40
		STR		R0,[R1]
		MOV		R5,#0x20				; ensure H=0
		BL		Out1BNokia	
		MOV		R5,#0x40				; set Y address to 0
		BL		Out1BNokia
		MOV		R5,#0x80				; set X address to 0
		BL		Out1BNokia	
waitClrReady		
		LDR		R1,=SSI0_SR				; wait until SSI is done
		LDR		R0,[R1]
		ANDS	R0,R0,#0x10
		BNE		waitClrReady
		LDR		R1,=GPIO_PORTA_DATA		; set PA6 high for Data
		LDR		R0,[R1]
		ORR		R0,#0x40
		STR		R0,[R1]	
		MOV		R0,#504					; 504 bytes in full image
		MOV		R5,#0x00				; load zeros to send
clrNxtNokia		
		BL		Out1BNokia
		SUBS	R0,#1
		BNE		clrNxtNokia
waitClrDone			
		LDR		R1,=SSI0_SR				; wait until SSI is done
		LDR		R0,[R1]
		ANDS	R0,R0,#0x10
		BNE		waitClrDone
		POP		{R0-R5,LR}
		BX		LR
;*****************************************************************
;*****************************************************************
; outputs cursor to LCD screen
OutCrsUNokia	
		PUSH	{R0-R5,LR}
		LDR		R1, =cursorU
		MOV		R3,#0x05 		;Each cursor has 5 bytes
		MUL		R2,R2,R3		;R2 decides which cursor to draw
		ADD		R1,R1,R2
		
		MOV		R2, #5					;counter for 5 characters
nextPxl
		LDRB	R5,[R1],#1
		CMP		R2,#0
		BEQ		waitCrsDone	
		BL		Out1BNokia
		SUB		R2,#1
		B		nextPxl
waitCrsDone		
		LDR		R1,=SSI0_SR				; wait until SSI is done
		LDR		R0,[R1]
		ANDS	R0,R0,#0x10
		BNE		waitCrsDone
		POP		{R0-R5,LR}
		BX		LR
;*****************************************************************
OutCrsLNokia	
		PUSH	{R0-R5,LR}
		LDR		R1, =cursorL
		MOV		R3,#0x05 		;Each cursor has 5 bytes
		SUB		R2, #4			;cursir b is needed 4 times
		MUL		R2,R2,R3		;R2 decides which cursor to draw
		ADD		R1,R1,R2
		
		MOV		R2, #5					;counter for 5 characters
nextLPxl
		LDRB	R5,[R1],#1
		CMP		R2,#0
		BEQ		waitLCrsDone	
		BL		Out1BNokia
		SUB		R2,#1
		B		nextLPxl
waitLCrsDone		
		LDR		R1,=SSI0_SR				; wait until SSI is done
		LDR		R0,[R1]
		ANDS	R0,R0,#0x10
		BNE		waitLCrsDone
		POP		{R0-R5,LR}
		BX		LR
;*****************************************************************
;*****************************************************************
; outputs battleship to LCD screen
OutBUNokia	
		PUSH	{R0-R5,LR}
		LDR		R1, =bshipU
		MOV		R3,#0x07 		;Each cursor has 7 bytes
		MUL		R2,R2,R3		;R2 decides which part of ship to draw
		ADD		R1,R1,R2
		
		MOV		R2, #7					;counter for 7 Bytes
nextBUPxl
		LDRB	R5,[R1],#1
		CMP		R2,#0
		BEQ		waitBUDone	
		BL		Out1BNokia
		SUB		R2,#1
		B		nextBUPxl
waitBUDone		
		LDR		R1,=SSI0_SR				; wait until SSI is done
		LDR		R0,[R1]
		ANDS	R0,R0,#0x10
		BNE		waitBUDone
		POP		{R0-R5,LR}
		BX		LR
;*****************************************************************
OutBLNokia	
		PUSH	{R0-R5,LR}
		LDR		R1, =bshipL
		MOV		R3,#0x07 		;Each cursor has 7 bytes
		MUL		R2,R2,R3		;R2 decides which part of ship to draw
		ADD		R1,R1,R2
		
		MOV		R2, #7					;counter for 7 bytes
nextBLPxl
		LDRB	R5,[R1],#1
		CMP		R2,#0
		BEQ		waitBLDone	
		BL		Out1BNokia
		SUB		R2,#1
		B		nextBLPxl
waitBLDone		
		LDR		R1,=SSI0_SR				; wait until SSI is done
		LDR		R0,[R1]
		ANDS	R0,R0,#0x10
		BNE		waitBLDone
		POP		{R0-R5,LR}
		BX		LR
;*****************************************************************
;*****************************************************************
; outputs civillian ship to LCD screen
OutCUNokia	
		PUSH	{R0-R5,LR}
		LDR		R1, =cshipU
		MOV		R3,#0x07 		;Each cursor has 7 bytes
		MUL		R2,R2,R3		;R2 decides which ship to draw
		ADD		R1,R1,R2
		
		MOV		R2, #7					;counter for 7 bytes
nextCUPxl
		LDRB	R5,[R1],#1
		CMP		R2,#0
		BEQ		waitCUDone	
		BL		Out1BNokia
		SUB		R2,#1
		B		nextCUPxl
waitCUDone		
		LDR		R1,=SSI0_SR				; wait until SSI is done
		LDR		R0,[R1]
		ANDS	R0,R0,#0x10
		BNE		waitCUDone
		POP		{R0-R5,LR}
		BX		LR
;*****************************************************************
OutCLNokia	
		PUSH	{R0-R5,LR}
		LDR		R1, =cshipL
		MOV		R3,#0x07 		;Each cursor has 7 bytes
		MUL		R2,R2,R3		;R2 decides which ship to draw
		ADD		R1,R1,R2
		
		MOV		R2, #7					;counter for 7 bytes
nextCLPxl
		LDRB	R5,[R1],#1
		CMP		R2,#0
		BEQ		waitCLDone	
		BL		Out1BNokia
		SUB		R2,#1
		B		nextCLPxl
waitCLDone		
		LDR		R1,=SSI0_SR				; wait until SSI is done
		LDR		R0,[R1]
		ANDS	R0,R0,#0x10
		BNE		waitCLDone
		POP		{R0-R5,LR}
		BX		LR
;*****************************************************************
;*****************************************************************
;clears only the gamefield so that timer or borders are not cleared at every cursor mmovement
Cleargamefield
		PUSH	{R0-R4,LR}
		PUSH	{R5}					; save Img address
		LDR		R5,=clearfield			; load img address of
		PUSH	{R5}					; save Img address
		LDR		R1,=GPIO_PORTA_DATA		; set PA6 low for Command
		LDR		R0,[R1]
		BIC		R0,#0x40
		STR		R0,[R1]
		MOV		R5,#0x20				; ensure H=0
		BL		Out1BNokia	
		MOV		R5,#0x41				; set Y address to 0
		BL		Out1BNokia
		MOV		R5,#0x80				; set X address to 0
		BL		Out1BNokia	
waitclearReady		
		LDR		R1,=SSI0_SR				; wait until SSI is done
		LDR		R0,[R1]
		ANDS	R0,R0,#0x10
		BNE		waitclearReady
		LDR		R1,=GPIO_PORTA_DATA		; ready: set PA6 high for Data
		LDR		R0,[R1]
		ORR		R0,#0x40
		STR		R0,[R1]	
		POP		{R5}
		MOV		R0,#420					; 420 bytes in clear image
		MOV		R1,R5					; put img address in R1
sendByteNokia		
		LDRB	R5,[R1],#1				; load R5 with byte, post inc address
		BL		Out1BNokia
		SUBS	R0,#1
		BNE		sendByteNokia		
		POP     {R5}
		POP		{R0-R4,LR}
		BX		LR
;*****************************************************************
hfmessage
		PUSH{R5,LR}
		BL	ClearNokia
		LDR R5,=faultmsg
		BL	OutStrNokia
		POP{R5,LR}
		BX	LR
		ALIGN
		END